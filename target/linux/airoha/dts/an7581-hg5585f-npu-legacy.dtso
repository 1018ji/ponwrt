// SPDX-License-Identifier: (GPL-2.0-only OR BSD-2-Clause)
/dts-v1/;
/plugin/;

#include <dt-bindings/reset/airoha,en7581-reset.h>

/* Explicit protocol-diagnostic overlay; stock WLAN ABI disables upstream PPE. */
&npu {
	reg = <0x0 0x1e900000 0x0 0x313000>,
	      <0x0 0x1fb30000 0x0 0x2b0>;
	reg-names = "npu", "rx-copy";
	resets = <&scuclk EN7581_NPU_RST>, <&scuclk EN7581_GDMA_RST>;
	reset-names = "npu", "rx-copy";
	airoha,wlan-firmware-abi = "hg5585f-2024";
	firmware-name = "airoha/hg5585f_npu_rv32.bin",
			"airoha/hg5585f_npu_data.bin";
};
